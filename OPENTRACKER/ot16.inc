
	.DEF _rx_wr_index=R5
	.DEF _rx_rd_index=R4
	.DEF _rx_counter=R7
	.DEF _tx_wr_index=R6
	.DEF _tx_rd_index=R9
	.DEF _tx_counter=R8
_flag:
	.DB  0x7E,0x7E,0x7E,0x7E,0x7E,0x7E,0x7E,0x7E
	.DB  0x7E,0x7E,0x7E,0x7E,0x7E,0x7E,0x7E,0x7E
	.DB  0x7E,0x7E,0x7E,0x7E,0x7E,0x7E,0x7E,0x7E
_ssid_2:
	.DB  0x64
_ssid_9:
	.DB  0x72
_ssid_2final:
	.DB  0x65
_control_field:
	.DB  0x3
_protocol_id:
	.DB  0xF0
_data_type:
	.DB  0x21
	.DEF _fcshi=R11
	.DEF _fcslo=R10
	.DEF _count_1=R13
	.DEF _x_counter=R12
_20:
	.DB  0xB0,0x4
_0x51:
	.DB  0x0,0x0

__GLOBAL_INI_TBL:
	.DW  0x02
	.DW  _tone
	.DW  _20*2

	.DW  0
_0x80:
