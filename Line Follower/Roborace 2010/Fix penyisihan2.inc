
	.DEF _sensor=R5
	.DEF _adc0=R4
	.DEF _adc1=R7
	.DEF _adc2=R6
	.DEF _adc3=R9
	.DEF _adc4=R8
	.DEF _adc5=R11
	.DEF _adc6=R10
	.DEF _adc7=R13
	.DEF _bt7=R12
_3:
	.DB  0x7
_4:
	.DB  0x7
_5:
	.DB  0x7
_6:
	.DB  0x7
_7:
	.DB  0x7
_8:
	.DB  0x7
_9:
	.DB  0x7
_10:
	.DB  0x9
_11:
	.DB  0x7
_12:
	.DB  0x7
_13:
	.DB  0x7
_14:
	.DB  0x7
_15:
	.DB  0x7
_16:
	.DB  0x7
_17:
	.DB  0x7
_18:
	.DB  0x9
_19:
	.DB  0x7
_20:
	.DB  0x7
_21:
	.DB  0x7
_22:
	.DB  0x7
_23:
	.DB  0x7
_24:
	.DB  0x7
_25:
	.DB  0x7
_26:
	.DB  0x9
_27:
	.DB  0xFF,0x0
_char0:
	.DB  0x60,0x18,0x6,0x7F,0x7F,0x6,0x18,0x60
_tbl10_G2:
	.DB  0x10,0x27,0xE8,0x3,0x64,0x0,0xA,0x0
	.DB  0x1,0x0
_tbl16_G2:
	.DB  0x0,0x10,0x0,0x1,0x10,0x0,0x1,0x0
_454:
	.DB  0x80,0xC0
_0:
	.DB  0x20,0x20,0x62,0x61,0x72,0x75,0x5F,0x62
	.DB  0x65,0x6C,0x61,0x6A,0x61,0x72,0x20,0x20
	.DB  0x0,0x20,0x20,0x20,0x20,0x20,0x20,0x62
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	.DB  0x20,0x20,0x20,0x20,0x20,0x0

__GLOBAL_INI_TBL:
	.DW  0x01
	.DW  0x0C
	.DW  _3*2

	.DW  0x01
	.DW  _bt6
	.DW  _4*2

	.DW  0x01
	.DW  _bt5
	.DW  _5*2

	.DW  0x01
	.DW  _bt4
	.DW  _6*2

	.DW  0x01
	.DW  _bt3
	.DW  _7*2

	.DW  0x01
	.DW  _bt2
	.DW  _8*2

	.DW  0x01
	.DW  _bt1
	.DW  _9*2

	.DW  0x01
	.DW  _bt0
	.DW  _10*2

	.DW  0x01
	.DW  _ba7
	.DW  _11*2

	.DW  0x01
	.DW  _ba6
	.DW  _12*2

	.DW  0x01
	.DW  _ba5
	.DW  _13*2

	.DW  0x01
	.DW  _ba4
	.DW  _14*2

	.DW  0x01
	.DW  _ba3
	.DW  _15*2

	.DW  0x01
	.DW  _ba2
	.DW  _16*2

	.DW  0x01
	.DW  _ba1
	.DW  _17*2

	.DW  0x01
	.DW  _ba0
	.DW  _18*2

	.DW  0x01
	.DW  _bb7
	.DW  _19*2

	.DW  0x01
	.DW  _bb6
	.DW  _20*2

	.DW  0x01
	.DW  _bb5
	.DW  _21*2

	.DW  0x01
	.DW  _bb4
	.DW  _22*2

	.DW  0x01
	.DW  _bb3
	.DW  _23*2

	.DW  0x01
	.DW  _bb2
	.DW  _24*2

	.DW  0x01
	.DW  _bb1
	.DW  _25*2

	.DW  0x01
	.DW  _bb0
	.DW  _26*2

	.DW  0x02
	.DW  _MAXPWM
	.DW  _27*2

	.DW  0x02
	.DW  __base_y_G3
	.DW  _454*2

	.DW  0
_0x1F4:
