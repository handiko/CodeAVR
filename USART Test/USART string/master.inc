
	.DEF _rx_wr_index=R5
	.DEF _rx_rd_index=R4
	.DEF _rx_counter=R7
	.DEF _tx_wr_index=R6
	.DEF _tx_rd_index=R9
	.DEF _tx_counter=R8
	.DEF _i=R10
	.DEF _j=R12
_43:
	.DB  0x80,0xC0
_0:
	.DB  0x50,0x65,0x73,0x61,0x6E,0x20,0x70,0x65
	.DB  0x72,0x74,0x61,0x6D,0x61,0x20,0x3A,0x20
	.DB  0x49,0x6E,0x69,0x20,0x61,0x64,0x61,0x6C
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	.DB  0x72,0x69,0x6D,0x20,0x21,0x0

__GLOBAL_INI_TBL:
	.DW  0x50
	.DW  _kalimat
	.DW  _0*2

	.DW  0x50
	.DW  _kalimat+0x50
	.DW  _0*2+0x50

	.DW  0x50
	.DW  _kalimat+0xA0
	.DW  _0*2+0xA0

	.DW  0x02
	.DW  __base_y_G2
	.DW  _43*2

	.DW  0
_0x36:
