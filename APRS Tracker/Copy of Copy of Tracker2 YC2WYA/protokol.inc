
	.DEF _rx_wr_index=R3
	.DEF _rx_rd_index=R2
	.DEF _rx_counter=R5
_flag:
	.DB  0x7E
_data:
	.DB  0x82,0xA0,0xAA,0x64,0x6A,0x9C,0x64,0xB2
	.DB  0x88,0x64,0x82,0xA0,0xA4,0x62,0xAE,0x92
	.DB  0x88,0x8A,0x64,0x40,0x64,0xAE,0x92,0x88
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	.DB  0xC8,0xD2,0xD6,0xDE,0x5A
	.DEF _fcshi=R4
	.DEF _fcslo=R7
	.DEF _count_1=R6
	.DEF _x_counter=R9
	.DEF _n=R8
_matrix:
	.DB  0x7,0xA,0xD,0xE,0xF,0xE,0xD,0xA
	.DB  0x7,0x5,0x2,0x1,0x0,0x1,0x2,0x5

;GPIOR0-GPIOR2 INITIALIZATION
	.EQU  __GPIOR0_INIT=0x00
	.EQU  __GPIOR1_INIT=0x00
	.EQU  __GPIOR2_INIT=0x00

__GLOBAL_INI_TBL:
	.DW  0
_0x4F:
