
_flag:
	.DB  0x7E
_matrix:
	.DB  0x7,0xA,0xD,0xE,0xF,0xE,0xD,0xA
	.DB  0x7,0x5,0x2,0x1,0x0,0x1,0x2,0x5
_data:
	.DB  0x82,0xA0,0xB4,0xA8,0x64,0x66,0xE0,0xB2
	.DB  0x88,0x64,0xB0,0x82,0x86,0x72,0xAE,0x92
	.DB  0x88,0x8A,0x62,0x40,0x62,0xAE,0x92,0x88
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	.DB  0x3A,0xD
_3:
	.DB  0x3D,0x30,0x37,0x34,0x35,0x2E,0x38,0x35
	.DB  0x53,0x48,0x31,0x31,0x30,0x32,0x32,0x2E
	.DB  0x35,0x32,0x45,0x26
	.DEF _n=R3
	.DEF _crc=R4
	.DEF _crc_lo_S5=R2
	.DEF _crc_hi_S5=R7
	.DEF _xor_S7=R8

;GPIOR0-GPIOR2 INITIALIZATION
	.EQU  __GPIOR0_INIT=0x00
	.EQU  __GPIOR1_INIT=0x00
	.EQU  __GPIOR2_INIT=0x00

__GLOBAL_INI_TBL:
	.DW  0x14
	.DW  _koordinat
	.DW  _3*2

	.DW  0
_0x3E:
