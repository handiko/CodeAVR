
	.DEF _rx_wr_index=R3
	.DEF _rx_rd_index=R2
	.DEF _rx_counter=R5
_flag:
	.DB  0x7E
_matrix:
	.DB  0x7,0xA,0xD,0xE,0xF,0xE,0xD,0xA
	.DB  0x7,0x5,0x2,0x1,0x0,0x1,0x2,0x5
_data:
	.DB  0x82,0xA0,0xB4,0xAA,0x8E,0x9A,0xE0,0x66
	.DB  0x6C,0x6E,0x60,0x72,0x40,0x72,0xAE,0x92
	.DB  0x88,0x8A,0x62,0x40,0x62,0xAE,0x92,0x88
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	.DB  0x3A,0x3A,0xD
_10:
	.DB  0x30,0x37,0x34,0x35,0x2E,0x33,0x31,0x53
	.DB  0x48,0x31,0x31,0x30,0x32,0x32,0x2E,0x35
	.DB  0x32,0x45,0x26
	.DEF __TCNT0=R6
	.DEF _crc=R8
	.DEF _crc_lo_S5=R4
	.DEF _crc_hi_S5=R11
	.DEF _xor_in_S7=R12

;GPIOR0-GPIOR2 INITIALIZATION
	.EQU  __GPIOR0_INIT=0x00
	.EQU  __GPIOR1_INIT=0x00
	.EQU  __GPIOR2_INIT=0x00

__GLOBAL_INI_TBL:
	.DW  0x13
	.DW  _posisi
	.DW  _10*2

	.DW  0
_0x50:
